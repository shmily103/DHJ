#include "st7789.h"
#include "spi.h"
#include <stdio.h>
#include <string.h>

/*
 * st7789.c
 * ------------------------------------------------------------
 * ST7789 驱动实现：负责控制屏幕初始化、窗口设置、
 * SPI 数据传输和缓存式渲染。
 *
 * 由于该屏幕的显示内容往往包括图标、菜单和数值标签，
 * 体验要求高速刷新并降低 CPU 占用。故实现中使用了命令队列、
 * 帧缓冲和 DMA 传输方式，把复杂绘制操作拆分为可批处理的步骤。
 */

extern SPI_HandleTypeDef hspi1;

static const uint8_t g_font5x7[] = {
  0x00, 0x00, 0x00, 0x00, 0x00, // (space)
  0x00, 0x00, 0x5F, 0x00, 0x00, // !
  0x00, 0x07, 0x00, 0x07, 0x00, // "
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  0x02, 0x01, 0x02, 0x04, 0x02, // ~
};

#define ST7789_FONT_WIDTH 5
#define ST7789_FONT_HEIGHT 7
#define ST7789_ASCII_SCALE 2
#define ST7789_ASCII_ADVANCE (ST7789_FONT_WIDTH * ST7789_ASCII_SCALE + 2)
#define ST7789_CJK_WIDTH 16
#define ST7789_CJK_HEIGHT 16
#define ST7789_RAMWR 0x2C
#define ST7789_CASET 0x2A
#define ST7789_RASET 0x2B

#define ST7789_COLOR_BLACK 0x0000
#define ST7789_COLOR_WHITE 0xFFFF
#define ST7789_COLOR_YELLOW 0xFFE0
#define ST7789_COLOR_BLUE 0x001F
#define ST7789_COLOR_GREEN 0x07E0
#define ST7789_COLOR_RED 0xF800
#define ST7789_FRAME_COMMAND_CAPACITY 112U
#define ST7789_FRAME_TEXT_CAPACITY 48U
#define ST7789_FRAME_TRANSFER_ROWS 2U
#define ST7789_FRAME_TASK_ROWS 8U

#define ST7789_CHAR_INDEX(c) ((uint8_t)(c) - 32)

typedef enum
{
  ST7789_FRAME_COMMAND_RECT = 0,
  ST7789_FRAME_COMMAND_TEXT = 1,
  ST7789_FRAME_COMMAND_BITMAP48 = 2
} ST7789_FrameCommandType_t;

typedef struct
{
  uint8_t type;
  uint16_t x;
  uint16_t y;
  union
  {
    struct
    {
      uint16_t w;
      uint16_t h;
      uint16_t color;
    } rect;
    struct
    {
      uint16_t fg_color;
      uint16_t bg_color;
      uint8_t scale;
      char text[ST7789_FRAME_TEXT_CAPACITY];
    } text;
    struct
    {
      uint16_t fg_color;
      uint16_t bg_color;
      const uint64_t *rows;
    } bitmap48;
  } data;
} ST7789_FrameCommand_t;

static ST7789_FrameCommand_t g_frame_commands[ST7789_FRAME_COMMAND_CAPACITY];
static uint16_t g_frame_command_count = 0U;
static uint16_t g_frame_background_color = 0U;
static uint8_t g_frame_active = 0U;
static uint8_t g_frame_rendering = 0U;
static uint8_t g_frame_dma_pending = 0U;
static uint8_t g_frame_setup_step = 0U;
static uint16_t g_frame_next_y = 0U;
static uint8_t g_frame_column_command = ST7789_CASET;
static uint8_t g_frame_row_command = ST7789_RASET;
static uint8_t g_frame_memory_command = ST7789_RAMWR;
static uint8_t g_frame_window_data[4U];
/* 双行 RGB565 发送缓冲区，避免为整屏像素额外占用 RAM。 */
static uint8_t g_frame_transfer_buffer[ST7789_WIDTH * 2U * ST7789_FRAME_TRANSFER_ROWS];

/*
 * ST7789_AppendRectCommand
 * ------------------------------------------------------------
 * 把矩形填充请求追加进入当前帧命令队列。
 *
 * 这里不直接执行屏幕写入，而是把绘制任务先缓存到 g_frame_commands[]
 * 中，待整个帧完成后再统一刷新到 LCD。
 *
 * 这样做的好处是：
 *   - 可合并多个绘制命令，减少 SPI 事务开销；
 *   - 可在一帧里一次性完成多块区域绘制；
 *   - 能降低 CPU 对 LCD 的频繁打断，提高系统实时性。
 */
static void ST7789_AppendRectCommand(uint16_t x, uint16_t y, uint16_t w, uint16_t h,
                                    uint16_t color)
{
  ST7789_FrameCommand_t *command = NULL;

  if (g_frame_command_count >= ST7789_FRAME_COMMAND_CAPACITY)
  {
    Error_Handler();
    return;
  }

  command = &g_frame_commands[g_frame_command_count++];
  command->type = ST7789_FRAME_COMMAND_RECT;
  command->x = x;
  command->y = y;
  command->data.rect.w = w;
  command->data.rect.h = h;
  command->data.rect.color = color;
}

/*
 * ST7789_AppendTextCommand
 * ------------------------------------------------------------
 * 将文本绘制请求加入当前帧缓存。
 *
 * 它会顺序记录：
 *   - 文字的位置；
 *   - 前景/背景色；
 *   - 缩放尺寸；
 *   - 字符串内容。
 *
 * 不在此函数中直接输出字模，而是把文本作为一条“绘图命令”保存，
 * 等待 ST7789_Task() 或 EndFrame 流程统一渲染。这样处理后，多个文
 * 本和图形对象可以被按顺序组合成一帧，而非逐个立刻写入屏幕。
 */
static void ST7789_AppendTextCommand(uint16_t x, uint16_t y, const char *str,
                                    uint16_t fg_color, uint16_t bg_color,
                                    uint8_t scale)
{
  ST7789_FrameCommand_t *command = NULL;
  size_t text_length = 0U;

  if (g_frame_command_count >= ST7789_FRAME_COMMAND_CAPACITY)
  {
    Error_Handler();
  }

  text_length = strlen(str);
  if (text_length >= ST7789_FRAME_TEXT_CAPACITY)
  {
    Error_Handler();
    return;
  }

  command = &g_frame_commands[g_frame_command_count++];
  command->type = ST7789_FRAME_COMMAND_TEXT;
  command->x = x;
  command->y = y;
  command->data.text.fg_color = fg_color;
  command->data.text.bg_color = bg_color;
  command->data.text.scale = scale;
  memcpy(command->data.text.text, str, text_length + 1U);
}

/* 将静态 48x48 位图作为帧命令排队，由帧渲染任务逐行合成。 */
static void ST7789_AppendBitmap48Command(uint16_t x, uint16_t y,
                                        const uint64_t *rows,
                                        uint16_t fg_color, uint16_t bg_color)
{
  ST7789_FrameCommand_t *command = NULL;

  if (g_frame_command_count >= ST7789_FRAME_COMMAND_CAPACITY)
  {
    Error_Handler();
    return;
  }

  command = &g_frame_commands[g_frame_command_count++];
  command->type = ST7789_FRAME_COMMAND_BITMAP48;
  command->x = x;
  command->y = y;
  command->data.bitmap48.fg_color = fg_color;
  command->data.bitmap48.bg_color = bg_color;
  command->data.bitmap48.rows = rows;
}

/*
 * ST7789_TransmitDma
 * ------------------------------------------------------------
 * 通过 SPI DMA 发送一段原始像素数据。
 *
 * 它的关键职责是：
 *   - 使用 HAL_SPI_Transmit_DMA() 触发真正的数据传输；
 *   - 轮询等待 SPI 结束；
 *   - 超时后中止传输并调用 Error_Handler()；
 *   - 若底层错误码不为 NONE，则立刻报错。
 *
 * 这一层封装的意义在于，将显示控制器的 DMA 访问封装起来，避免
 * 其余绘图逻辑需要了解 SPI 状态机和错误处理细节。
 */
static void ST7789_TransmitDma(uint8_t *data, uint16_t len)
{
  uint32_t start_tick = HAL_GetTick();

  if (HAL_SPI_Transmit_DMA(&hspi1, data, len) != HAL_OK)
  {
    Error_Handler();
  }

  while (HAL_SPI_GetState(&hspi1) == HAL_SPI_STATE_BUSY_TX)
  {
    if ((uint32_t)(HAL_GetTick() - start_tick) >= 100U)
    {
      (void)HAL_SPI_Abort(&hspi1);
      Error_Handler();
    }
  }

  if (hspi1.ErrorCode != HAL_SPI_ERROR_NONE)
  {
    Error_Handler();
  }
}

static void ST7789_StartFrameDma(uint8_t *data, uint16_t len)
{
  if (HAL_SPI_Transmit_DMA(&hspi1, data, len) != HAL_OK)
  {
    Error_Handler();
  }
}

typedef struct
{
  uint16_t codepoint;
  uint16_t rows[ST7789_CJK_HEIGHT];
  uint8_t reverse_rows;
} ST7789_CjkGlyph_t;

static const ST7789_CjkGlyph_t g_cjk_font[] =
{
  {0x70B9U, {0x6000U, 0xE767U, 0x766EU, 0x36EEU, 0x304CU, 0x1FF8U, 0x1FF8U, 0x1818U, 0x1FF8U, 0x1FF8U, 0x0380U, 0x03FCU, 0x03FEU, 0x03FCU, 0x0380U, 0x0100U}, 1U},
  {0x710AU, {0x0070U, 0xE070U, 0x7070U, 0x73FFU, 0x3FFFU, 0x3E72U, 0x3FFEU, 0xFBFEU, 0xF9FCU, 0x79FEU, 0x7FFEU, 0x7FFEU, 0x1D8EU, 0x39FEU, 0x39FCU, 0x1000U}, 1U},
  {0x673AU, {0x1E00U, 0x3F1EU, 0x3F1FU, 0x1B9FU, 0xFB9AU, 0xF998U, 0x7F98U, 0x7F98U, 0x3D98U, 0x3998U, 0xFF98U, 0x7F98U, 0x19F8U, 0x19F8U, 0x39F8U, 0x0000U}, 1U},
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  {0x8BAEU, {0x1600U, 0x3F8EU, 0x3FDFU, 0x3DFEU, 0x3EF0U, 0x3EF0U, 0x39F8U, 0x39B8U, 0x7998U, 0xFBFCU, 0x536CU, 0x1B6CU, 0x1F6EU, 0x38EEU, 0x38C0U, 0x0040U}, 1U},
};

/* 解码字符串中的一个 UTF-8 字符并推进读取位置。 */
static uint8_t ST7789_ReadUtf8Codepoint(const char *str, uint16_t *index, uint32_t *codepoint)
{
  /* 字符串仅需支持界面使用的 UTF-8；无效序列替换为问号并跳过续字节。 */
  uint8_t first = (uint8_t)str[*index];

  if (first < 0x80U)
  {
    *codepoint = first;
    (*index)++;
    return 1U;
  }
  if ((first & 0xE0U) == 0xC0U && str[*index + 1U] != '\0' &&
      ((uint8_t)str[*index + 1U] & 0xC0U) == 0x80U)
  {
    *codepoint = ((uint32_t)(first & 0x1FU) << 6) |
                 ((uint32_t)((uint8_t)str[*index + 1U] & 0x3FU));
    *index += 2U;
    return 1U;
  }
  if ((first & 0xF0U) == 0xE0U && str[*index + 1U] != '\0' && str[*index + 2U] != '\0' &&
      ((uint8_t)str[*index + 1U] & 0xC0U) == 0x80U &&
      ((uint8_t)str[*index + 2U] & 0xC0U) == 0x80U)
  {
    *codepoint = ((uint32_t)(first & 0x0FU) << 12) |
                 ((uint32_t)((uint8_t)str[*index + 1U] & 0x3FU) << 6) |
                 ((uint32_t)((uint8_t)str[*index + 2U] & 0x3FU));
    *index += 3U;
    return 1U;
  }

  *codepoint = '?';
  (*index)++;
  while ((((uint8_t)str[*index]) & 0xC0U) == 0x80U)
  {
    (*index)++;
  }
  return 0U;
}

/* 按 Unicode 码点查找内置中文字模。 */
static const ST7789_CjkGlyph_t *ST7789_FindCjkGlyph(uint32_t codepoint)
{
  uint16_t i = 0U;

  for (i = 0U; i < (uint16_t)(sizeof(g_cjk_font) / sizeof(g_cjk_font[0])); i++)
  {
    if (g_cjk_font[i].codepoint == codepoint)
    {
      return &g_cjk_font[i];
    }
  }

  return NULL;
}

/* 将帧命令中的一行 ASCII/中文文字栅格化到像素缓冲区。 */
static void ST7789_RenderTextRow(const ST7789_FrameCommand_t *command, uint16_t y,
                                uint16_t *row_pixels)
{
  uint16_t index = 0U;
  uint32_t cursor_x = command->x;
  const uint32_t relative_y = (uint32_t)y - command->y;
  const char *str = command->data.text.text;
  const uint8_t scale = command->data.text.scale;
  const uint8_t ascii_width =
    (uint8_t)((ST7789_FONT_WIDTH * scale + 1U) / 2U);
  const uint8_t ascii_height =
    (uint8_t)((ST7789_FONT_HEIGHT * scale + 1U) / 2U);
  const uint8_t cjk_size = (uint8_t)(ST7789_CJK_WIDTH * scale / 4U);

  while (str[index] != '\0')
  {
    uint32_t codepoint = 0U;
    uint8_t is_valid = ST7789_ReadUtf8Codepoint(str, &index, &codepoint);

    if (codepoint < 0x80U)
    {
      uint8_t ch = (uint8_t)codepoint;
      if (ch < 32U || ch > 126U)
      {
        ch = '?';
      }

      if (relative_y < ascii_height)
      {
        uint8_t output_col = 0U;
        uint8_t source_row = (uint8_t)(relative_y * 2U / scale);

        for (output_col = 0U; output_col < ascii_width; output_col++)
        {
          uint8_t source_col = (uint8_t)(output_col * 2U / scale);
          uint8_t font_byte =
            g_font5x7[(ch - 32U) * ST7789_FONT_WIDTH + source_col];
          uint32_t pixel_x = cursor_x + output_col;
          if (pixel_x < ST7789_WIDTH)
          {
            row_pixels[pixel_x] =
              ((font_byte >> source_row) & 0x01U) != 0U ?
              command->data.text.fg_color : command->data.text.bg_color;
          }
        }
      }

      cursor_x += ascii_width + 2U;
    }
    else
    {
      const ST7789_CjkGlyph_t *glyph = is_valid ? ST7789_FindCjkGlyph(codepoint) : NULL;

      if (relative_y < cjk_size)
      {
        if (glyph != NULL)
        {
          uint8_t col = 0U;
          uint8_t glyph_row = (uint8_t)(relative_y * 4U / scale);
          if (glyph->reverse_rows != 0U)
          {
            glyph_row = (uint8_t)(ST7789_CJK_HEIGHT - 1U - glyph_row);
          }
          for (col = 0U; col < cjk_size; col++)
          {
            uint32_t pixel_x = cursor_x + col;
            if (pixel_x < ST7789_WIDTH)
            {
              uint8_t glyph_col = (uint8_t)(col * 4U / scale);
              row_pixels[pixel_x] =
                ((glyph->rows[glyph_row] &
                  (uint16_t)(0x8000U >> glyph_col)) != 0U) ?
                command->data.text.fg_color : command->data.text.bg_color;
            }
          }
        }
        else if (cursor_x < ST7789_WIDTH)
        {
          uint8_t col = 0U;
          if (relative_y < ascii_height)
          {
            uint8_t source_row = (uint8_t)(relative_y * 2U / scale);
            for (col = 0U; col < ascii_width; col++)
            {
              uint8_t source_col = (uint8_t)(col * 2U / scale);
              uint8_t font_byte =
                g_font5x7[('?' - 32) * ST7789_FONT_WIDTH + source_col];
              uint16_t color = ((font_byte >> source_row) & 0x01U) != 0U ?
                               command->data.text.fg_color : command->data.text.bg_color;
              uint32_t pixel_x = cursor_x + col;
              if (pixel_x < ST7789_WIDTH)
              {
                row_pixels[pixel_x] = color;
              }
            }
          }
        }
      }

      cursor_x += cjk_size;
    }
  }
}

/* 开始缓存一帧绘图命令并设置整帧背景色。 */
void ST7789_BeginFrame(uint16_t background_color)
{
  if ((g_frame_active != 0U) || (g_frame_rendering != 0U))
  {
    Error_Handler();
    return;
  }

  g_frame_active = 1U;
  g_frame_command_count = 0U;
  g_frame_background_color = background_color;
}

/* 合成当前帧的绘图命令，并启动分批刷屏。 */
void ST7789_EndFrame(void)
{
  if (g_frame_active == 0U)
  {
    Error_Handler();
    return;
  }

  g_frame_active = 0U;
  g_frame_rendering = 1U;
  g_frame_dma_pending = 0U;
  g_frame_setup_step = 0U;
  g_frame_next_y = 0U;
}

/* 每次仅提交一段 DMA，命令和像素均通过状态机异步发送。 */
void ST7789_Task(void)
{
  uint16_t rows_remaining = 0U;

  if (g_frame_rendering == 0U)
  {
    return;
  }

  if (g_frame_dma_pending != 0U)
  {
    if (HAL_SPI_GetState(&hspi1) == HAL_SPI_STATE_BUSY_TX)
    {
      return;
    }
    if (hspi1.ErrorCode != HAL_SPI_ERROR_NONE)
    {
      Error_Handler();
      return;
    }
    g_frame_dma_pending = 0U;
    if (g_frame_next_y >= ST7789_HEIGHT)
    {
      HAL_GPIO_WritePin(TFT_CS_GPIO_Port, TFT_CS_Pin, GPIO_PIN_SET);
      g_frame_rendering = 0U;
      g_frame_command_count = 0U;
      return;
    }
  }

  if (g_frame_setup_step < 6U)
  {
    switch (g_frame_setup_step)
    {
      case 0U:
        g_frame_window_data[0] = 0U;
        g_frame_window_data[1] = 0U;
        g_frame_window_data[2] = (uint8_t)((ST7789_WIDTH - 1U) >> 8U);
        g_frame_window_data[3] = (uint8_t)(ST7789_WIDTH - 1U);
        HAL_GPIO_WritePin(TFT_CS_GPIO_Port, TFT_CS_Pin, GPIO_PIN_RESET);
        HAL_GPIO_WritePin(TFT_DC_GPIO_Port, TFT_DC_Pin, GPIO_PIN_RESET);
        ST7789_StartFrameDma(&g_frame_column_command, 1U);
        break;
      case 1U:
        HAL_GPIO_WritePin(TFT_DC_GPIO_Port, TFT_DC_Pin, GPIO_PIN_SET);
        ST7789_StartFrameDma(g_frame_window_data, sizeof(g_frame_window_data));
        break;
      case 2U:
        HAL_GPIO_WritePin(TFT_DC_GPIO_Port, TFT_DC_Pin, GPIO_PIN_RESET);
        ST7789_StartFrameDma(&g_frame_row_command, 1U);
        break;
      case 3U:
        g_frame_window_data[0] = 0U;
        g_frame_window_data[1] = 0U;
        g_frame_window_data[2] = (uint8_t)((ST7789_HEIGHT - 1U) >> 8U);
        g_frame_window_data[3] = (uint8_t)(ST7789_HEIGHT - 1U);
        HAL_GPIO_WritePin(TFT_DC_GPIO_Port, TFT_DC_Pin, GPIO_PIN_SET);
        ST7789_StartFrameDma(g_frame_window_data, sizeof(g_frame_window_data));
        break;
      case 4U:
        HAL_GPIO_WritePin(TFT_DC_GPIO_Port, TFT_DC_Pin, GPIO_PIN_RESET);
        ST7789_StartFrameDma(&g_frame_memory_command, 1U);
        break;
      default:
        HAL_GPIO_WritePin(TFT_DC_GPIO_Port, TFT_DC_Pin, GPIO_PIN_SET);
        g_frame_setup_step = 6U;
        break;
    }

    if (g_frame_setup_step < 5U)
    {
      g_frame_setup_step++;
      g_frame_dma_pending = 1U;
      return;
    }
    if (g_frame_setup_step == 5U)
    {
      g_frame_setup_step++;
      g_frame_dma_pending = 1U;
      return;
    }
  }

  rows_remaining = (uint16_t)(ST7789_HEIGHT - g_frame_next_y);
  if (rows_remaining > ST7789_FRAME_TASK_ROWS)
  {
    rows_remaining = ST7789_FRAME_TASK_ROWS;
  }

  {
    uint16_t row_pixels[ST7789_WIDTH];
    uint16_t rows_to_send = (rows_remaining > ST7789_FRAME_TRANSFER_ROWS) ?
                            ST7789_FRAME_TRANSFER_ROWS : rows_remaining;
    uint16_t row = 0U;
    uint16_t command_index = 0U;

    for (row = 0U; row < rows_to_send; row++)
    {
      uint16_t x = 0U;
      uint16_t current_y = (uint16_t)(g_frame_next_y + row);
      for (x = 0U; x < ST7789_WIDTH; x++)
      {
        row_pixels[x] = g_frame_background_color;
      }

      for (command_index = 0U; command_index < g_frame_command_count; command_index++)
      {
        const ST7789_FrameCommand_t *command = &g_frame_commands[command_index];
        if (command->type == ST7789_FRAME_COMMAND_RECT)
        {
          uint32_t rect_bottom = (uint32_t)command->y + command->data.rect.h;
          uint32_t rect_right = (uint32_t)command->x + command->data.rect.w;
          uint32_t x_end = (rect_right > ST7789_WIDTH) ? ST7789_WIDTH : rect_right;
          uint32_t fill_x = command->x;
          if ((current_y >= command->y) && ((uint32_t)current_y < rect_bottom))
          {
            for (; fill_x < x_end; fill_x++)
            {
              row_pixels[fill_x] = command->data.rect.color;
            }
          }
        }
        else if ((command->type == ST7789_FRAME_COMMAND_TEXT) &&
                 (current_y >= command->y) &&
                 ((uint32_t)current_y < (uint32_t)command->y +
                     (ST7789_CJK_HEIGHT * command->data.text.scale / 4U)))
        {
          ST7789_RenderTextRow(command, current_y, row_pixels);
        }
        else if ((command->type == ST7789_FRAME_COMMAND_BITMAP48) &&
                 (current_y >= command->y) &&
                 ((uint32_t)current_y < (uint32_t)command->y + 48U))
        {
          uint8_t column = 0U;
          uint8_t bitmap_row = (uint8_t)(current_y - command->y);
          for (column = 0U; column < 48U; column++)
          {
            uint16_t pixel_x = (uint16_t)(command->x + column);
            row_pixels[pixel_x] =
                ((command->data.bitmap48.rows[bitmap_row] &
                  (1ULL << (47U - column))) != 0ULL) ?
                command->data.bitmap48.fg_color :
                command->data.bitmap48.bg_color;
          }
        }
      }

      for (x = 0U; x < ST7789_WIDTH; x++)
      {
        uint16_t buffer_index = (uint16_t)(row * ST7789_WIDTH * 2U + x * 2U);
        g_frame_transfer_buffer[buffer_index] = (uint8_t)(row_pixels[x] >> 8);
        g_frame_transfer_buffer[buffer_index + 1U] = (uint8_t)row_pixels[x];
      }
    }

    ST7789_StartFrameDma(g_frame_transfer_buffer,
                         (uint16_t)(rows_to_send * ST7789_WIDTH * 2U));
    g_frame_dma_pending = 1U;
    g_frame_next_y = (uint16_t)(g_frame_next_y + rows_to_send);
  }
}

/* 返回整帧是否仍在分批传输。 */
uint8_t ST7789_FrameIsBusy(void)
{
  return g_frame_rendering;
}

/* 将指定中文字模按 RGB565 像素写入显示区域。 */
static void ST7789_DrawCjkGlyph(uint16_t x, uint16_t y, const ST7789_CjkGlyph_t *glyph,
                                uint16_t fg_color, uint16_t bg_color)
{
  uint8_t row = 0U;
  uint8_t col = 0U;
  uint8_t row_data[ST7789_CJK_WIDTH * 2U];

  ST7789_SetWindow(x, y, x + ST7789_CJK_WIDTH - 1U, y + ST7789_CJK_HEIGHT - 1U);
  ST7789_WriteCommand(ST7789_RAMWR);
  HAL_GPIO_WritePin(TFT_DC_GPIO_Port, TFT_DC_Pin, GPIO_PIN_SET);
  HAL_GPIO_WritePin(TFT_CS_GPIO_Port, TFT_CS_Pin, GPIO_PIN_RESET);

  for (row = 0U; row < ST7789_CJK_HEIGHT; row++)
  {
    uint8_t glyph_row = (glyph->reverse_rows != 0U) ?
                        (uint8_t)(ST7789_CJK_HEIGHT - 1U - row) : row;
    for (col = 0U; col < ST7789_CJK_WIDTH; col++)
    {
      uint16_t color = ((glyph->rows[glyph_row] & (uint16_t)(0x8000U >> col)) != 0U) ? fg_color : bg_color;
      row_data[col * 2U] = (uint8_t)(color >> 8);
      row_data[col * 2U + 1U] = (uint8_t)color;
    }
    ST7789_TransmitDma(row_data, sizeof(row_data));
  }

  HAL_GPIO_WritePin(TFT_CS_GPIO_Port, TFT_CS_Pin, GPIO_PIN_SET);
}

/* 按内置 5x7 字模绘制放大的单个 ASCII 字符。 */
static void ST7789_DrawChar(uint16_t x, uint16_t y, char ch, uint16_t fg_color, uint16_t bg_color)
{
  uint8_t col = 0;
  uint8_t row = 0;
  uint8_t byte = 0;
  uint8_t scale_x = 0;
  uint8_t scale_y = 0;
  uint8_t row_data[ST7789_FONT_WIDTH * ST7789_ASCII_SCALE * 2U];
  uint16_t index = ST7789_CHAR_INDEX(ch);

  if (ch < 32 || ch > 126)
  {
    ch = '?';
    index = ST7789_CHAR_INDEX(ch);
  }

  ST7789_SetWindow(x, y,
                   x + ST7789_FONT_WIDTH * ST7789_ASCII_SCALE - 1U,
                   y + ST7789_FONT_HEIGHT * ST7789_ASCII_SCALE - 1U);
  ST7789_WriteCommand(ST7789_RAMWR);
  HAL_GPIO_WritePin(TFT_DC_GPIO_Port, TFT_DC_Pin, GPIO_PIN_SET);
  HAL_GPIO_WritePin(TFT_CS_GPIO_Port, TFT_CS_Pin, GPIO_PIN_RESET);

  for (row = 0U; row < ST7789_FONT_HEIGHT; row++)
  {
    for (scale_y = 0U; scale_y < ST7789_ASCII_SCALE; scale_y++)
    {
      uint8_t pos = 0U;
      for (col = 0U; col < ST7789_FONT_WIDTH; col++)
      {
        byte = g_font5x7[index * ST7789_FONT_WIDTH + col];
        for (scale_x = 0U; scale_x < ST7789_ASCII_SCALE; scale_x++)
        {
          uint16_t color = ((byte >> row) & 0x01U) != 0U ? fg_color : bg_color;
          row_data[pos++] = (uint8_t)(color >> 8);
          row_data[pos++] = (uint8_t)color;
        }
      }
      ST7789_TransmitDma(row_data, sizeof(row_data));
    }
  }

  HAL_GPIO_WritePin(TFT_CS_GPIO_Port, TFT_CS_Pin, GPIO_PIN_SET);
}

#define ST7789_MADCTL 0x36
#define ST7789_COLMOD 0x3A
#define ST7789_DISPON 0x29
#define ST7789_SLPOUT 0x11
#define ST7789_SWRESET 0x01
#define ST7789_INVON 0x21
#define ST7789_NORON 0x13

#define ST7789_RGB565(r, g, b) ((uint16_t)(((r & 0xF8) << 8) | ((g & 0xFC) << 3) | ((b & 0xF8) >> 3)))

/* 设置命令/数据模式并通过 SPI 阻塞发送数据。 */
static void ST7789_Send(uint8_t *data, uint16_t len, uint8_t is_data)
{
  HAL_GPIO_WritePin(TFT_DC_GPIO_Port, TFT_DC_Pin, is_data ? GPIO_PIN_SET : GPIO_PIN_RESET);
  HAL_GPIO_WritePin(TFT_CS_GPIO_Port, TFT_CS_Pin, GPIO_PIN_RESET);
  HAL_SPI_Transmit(&hspi1, data, len, 100);
  HAL_GPIO_WritePin(TFT_CS_GPIO_Port, TFT_CS_Pin, GPIO_PIN_SET);
}

/* 执行 ST7789 硬件复位并等待芯片稳定。 */
void ST7789_Reset(void)
{
  HAL_GPIO_WritePin(TFT_RES_GPIO_Port, TFT_RES_Pin, GPIO_PIN_RESET);
  HAL_Delay(20);
  HAL_GPIO_WritePin(TFT_RES_GPIO_Port, TFT_RES_Pin, GPIO_PIN_SET);
  HAL_Delay(120);
}

/* 向 ST7789 发送一条控制命令。 */
void ST7789_WriteCommand(uint8_t cmd)
{
  ST7789_Send(&cmd, 1, 0);
}

/* 向 ST7789 发送一个参数数据字节。 */
void ST7789_WriteData(uint8_t data)
{
  ST7789_Send(&data, 1, 1);
}

/* 设置后续像素写入使用的显示窗口坐标。 */
void ST7789_SetWindow(uint16_t x0, uint16_t y0, uint16_t x1, uint16_t y1)
{
  uint8_t data[4];

  data[0] = (x0 >> 8) & 0xFF;
  data[1] = x0 & 0xFF;
  data[2] = (x1 >> 8) & 0xFF;
  data[3] = x1 & 0xFF;

  ST7789_WriteCommand(ST7789_CASET);
  ST7789_WriteData(data[0]);
  ST7789_WriteData(data[1]);
  ST7789_WriteData(data[2]);
  ST7789_WriteData(data[3]);

  data[0] = (y0 >> 8) & 0xFF;
  data[1] = y0 & 0xFF;
  data[2] = (y1 >> 8) & 0xFF;
  data[3] = y1 & 0xFF;

  ST7789_WriteCommand(ST7789_RASET);
  ST7789_WriteData(data[0]);
  ST7789_WriteData(data[1]);
  ST7789_WriteData(data[2]);
  ST7789_WriteData(data[3]);
}

/* 以指定 RGB565 颜色填充矩形或缓存矩形绘图命令。 */
void ST7789_FillRect(uint16_t x, uint16_t y, uint16_t w, uint16_t h, uint16_t color)
{
  static uint8_t pixel_buffer[512U];
  uint32_t bytes_remaining = (uint32_t)w * (uint32_t)h * 2U;
  uint16_t chunk_size = 0U;
  uint16_t i = 0U;

  if (w == 0 || h == 0)
  {
    return;
  }

  if (g_frame_active != 0U)
  {
    ST7789_AppendRectCommand(x, y, w, h, color);
    return;
  }

  for (i = 0U; i < sizeof(pixel_buffer); i += 2U)
  {
    pixel_buffer[i] = (uint8_t)(color >> 8);
    pixel_buffer[i + 1U] = (uint8_t)color;
  }

  ST7789_SetWindow(x, y, x + w - 1, y + h - 1);
  ST7789_WriteCommand(ST7789_RAMWR);

  HAL_GPIO_WritePin(TFT_DC_GPIO_Port, TFT_DC_Pin, GPIO_PIN_SET);
  HAL_GPIO_WritePin(TFT_CS_GPIO_Port, TFT_CS_Pin, GPIO_PIN_RESET);

  while (bytes_remaining > 0U)
  {
    chunk_size = (bytes_remaining > sizeof(pixel_buffer)) ?
                 (uint16_t)sizeof(pixel_buffer) : (uint16_t)bytes_remaining;
    ST7789_TransmitDma(pixel_buffer, chunk_size);
    bytes_remaining -= chunk_size;
  }

  HAL_GPIO_WritePin(TFT_CS_GPIO_Port, TFT_CS_Pin, GPIO_PIN_SET);
}

/* 校验并解码 RLE 调色板图像到显示屏指定区域。 */
uint8_t ST7789_DrawRleImage(uint16_t x, uint16_t y, uint16_t w, uint16_t h,
                            const uint8_t *rle, uint32_t rle_size,
                            const uint16_t *palette, uint8_t palette_size,
                            uint8_t palette_index_bits)
{
  uint8_t row_data[ST7789_WIDTH * 2U];
  uint32_t total_pixels = (uint32_t)w * (uint32_t)h;
  uint32_t decoded_pixels = 0U;
  uint32_t offset = 0U;
  uint16_t column = 0U;
  uint8_t palette_index_mask = 0U;

  if ((w == 0U) || (h == 0U) || (x >= ST7789_WIDTH) || (y >= ST7789_HEIGHT) ||
      (w > (ST7789_WIDTH - x)) || (h > (ST7789_HEIGHT - y)) ||
      (rle == NULL) || (rle_size == 0U) || (palette == NULL) ||
      (palette_size == 0U) || (palette_index_bits == 0U) ||
      (palette_index_bits > 4U) ||
      (palette_size > (uint8_t)(1U << palette_index_bits)))
  {
    return 0U;
  }

  /* 先完整验证 RLE 长度和调色板索引，避免错误数据导致只画出半张图。 */
  palette_index_mask = (uint8_t)((1U << palette_index_bits) - 1U);
  while (offset < rle_size)
  {
    uint8_t token = rle[offset++];
    uint32_t run_length = (uint32_t)(token >> palette_index_bits) + 1U;
    uint8_t palette_index = token & palette_index_mask;

    if ((palette_index >= palette_size) || (run_length > (total_pixels - decoded_pixels)))
    {
      return 0U;
    }
    decoded_pixels += run_length;
  }

  if (decoded_pixels != total_pixels)
  {
    return 0U;
  }

  ST7789_SetWindow(x, y, x + w - 1U, y + h - 1U);
  ST7789_WriteCommand(ST7789_RAMWR);
  HAL_GPIO_WritePin(TFT_DC_GPIO_Port, TFT_DC_Pin, GPIO_PIN_SET);
  HAL_GPIO_WritePin(TFT_CS_GPIO_Port, TFT_CS_Pin, GPIO_PIN_RESET);

  for (offset = 0U; offset < rle_size; offset++)
  {
    uint8_t token = rle[offset];
    uint32_t run_length = (uint32_t)(token >> palette_index_bits) + 1U;
    uint16_t color = palette[token & palette_index_mask];

    while (run_length > 0U)
    {
      row_data[column * 2U] = (uint8_t)(color >> 8);
      row_data[(column * 2U) + 1U] = (uint8_t)color;
      column++;
      run_length--;

      if (column == w)
      {
        ST7789_TransmitDma(row_data, (uint16_t)(w * 2U));
        column = 0U;
      }
    }
  }

  HAL_GPIO_WritePin(TFT_CS_GPIO_Port, TFT_CS_Pin, GPIO_PIN_SET);
  return 1U;
}

/* 绘制指定半径和颜色的实心圆角矩形。 */
void ST7789_FillRoundRect(uint16_t x, uint16_t y, uint16_t w, uint16_t h, uint16_t radius, uint16_t color)
{
  uint16_t row = 0U;

  if (w == 0U || h == 0U)
  {
    return;
  }
  if (radius > w / 2U)
  {
    radius = w / 2U;
  }
  if (radius > h / 2U)
  {
    radius = h / 2U;
  }

  if (h > 2U * radius)
  {
    ST7789_FillRect(x, y + radius, w, h - 2U * radius, color);
  }

  for (row = 0U; row < radius; row++)
  {
    uint16_t inset = 0U;
    uint32_t dy = (uint32_t)(radius - row);
    uint16_t dx = 0U;

    while (dx < radius &&
           ((uint32_t)(dx + 1U) * (dx + 1U) + dy * dy) <= (uint32_t)radius * radius)
    {
      dx++;
    }
    inset = (uint16_t)(radius - dx);

    ST7789_FillRect(x + inset, y + row, w - 2U * inset, 1U, color);
    ST7789_FillRect(x + inset, y + h - 1U - row, w - 2U * inset, 1U, color);
  }
}

/* 使用指定颜色填满整个显示屏。 */
void ST7789_FillScreen(uint16_t color)
{
  ST7789_FillRect(0, 0, ST7789_WIDTH, ST7789_HEIGHT, color);
}

/* 在指定坐标绘制一个 RGB565 像素。 */
void ST7789_DrawPixel(uint16_t x, uint16_t y, uint16_t color)
{
  ST7789_FillRect(x, y, 1, 1, color);
}

/* 绘制支持 UTF-8 中文和 ASCII 的普通字号字符串。 */
void ST7789_DrawString(uint16_t x, uint16_t y, const char *str, uint16_t fg_color, uint16_t bg_color)
{
  uint16_t cursor_x = x;
  uint16_t i = 0U;

  if (str == NULL)
  {
    return;
  }

  if (g_frame_active != 0U)
  {
    ST7789_AppendTextCommand(x, y, str, fg_color, bg_color,
                             ST7789_ASCII_SCALE * 2U);
    return;
  }

  while (str[i] != '\0')
  {
    uint32_t codepoint = 0U;
    uint8_t is_valid = ST7789_ReadUtf8Codepoint(str, &i, &codepoint);
    if (codepoint < 0x80U)
    {
      ST7789_DrawChar(cursor_x, y, (char)codepoint, fg_color, bg_color);
      cursor_x += ST7789_ASCII_ADVANCE;
    }
    else
    {
      const ST7789_CjkGlyph_t *glyph = is_valid ? ST7789_FindCjkGlyph(codepoint) : NULL;
      if (glyph != NULL)
      {
        ST7789_DrawCjkGlyph(cursor_x, y, glyph, fg_color, bg_color);
      }
      else
      {
        ST7789_DrawChar(cursor_x, y, '?', fg_color, bg_color);
      }
      cursor_x += ST7789_CJK_WIDTH;
    }
  }
}

/* 在帧缓存模式下添加大字号字符串绘制命令。 */
void ST7789_DrawStringLarge(uint16_t x, uint16_t y, const char *str,
                            uint16_t fg_color, uint16_t bg_color)
{
  if (str == NULL)
  {
    return;
  }
  if (g_frame_active == 0U)
  {
    Error_Handler();
    return;
  }
  ST7789_AppendTextCommand(x, y, str, fg_color, bg_color, 5U);
}

/* 绘制按行编码的 48x48 单色位图。 */
void ST7789_DrawBitmap48(uint16_t x, uint16_t y, const uint64_t *rows,
                         uint16_t fg_color, uint16_t bg_color)
{
  uint8_t row_data[48U * 2U];
  uint16_t row = 0U;

  if ((rows == NULL) ||
      (x > ST7789_WIDTH - 48U) || (y > ST7789_HEIGHT - 48U))
  {
    return;
  }

  if (g_frame_active != 0U)
  {
    ST7789_AppendBitmap48Command(x, y, rows, fg_color, bg_color);
    return;
  }

  ST7789_SetWindow(x, y, x + 47U, y + 47U);
  ST7789_WriteCommand(ST7789_RAMWR);
  HAL_GPIO_WritePin(TFT_DC_GPIO_Port, TFT_DC_Pin, GPIO_PIN_SET);
  HAL_GPIO_WritePin(TFT_CS_GPIO_Port, TFT_CS_Pin, GPIO_PIN_RESET);

  for (row = 0U; row < 48U; row++)
  {
    uint8_t column = 0U;
    uint16_t offset = 0U;

    for (column = 0U; column < 48U; column++)
    {
      uint16_t color = (rows[row] & (1ULL << (47U - column))) != 0ULL ?
                       fg_color : bg_color;
      row_data[offset++] = (uint8_t)(color >> 8);
      row_data[offset++] = (uint8_t)color;
    }
    ST7789_TransmitDma(row_data, sizeof(row_data));
  }

  HAL_GPIO_WritePin(TFT_CS_GPIO_Port, TFT_CS_Pin, GPIO_PIN_SET);
}

/* 计算普通字号 UTF-8 字符串在屏幕上的显示宽度。 */
uint16_t ST7789_GetStringWidth(const char *str)
{
  uint16_t width = 0U;
  uint16_t i = 0U;

  if (str == NULL)
  {
    return 0U;
  }

  while (str[i] != '\0')
  {
    uint32_t codepoint = 0U;
    uint8_t is_valid = ST7789_ReadUtf8Codepoint(str, &i, &codepoint);
    if (codepoint < 0x80U)
    {
      width += ST7789_ASCII_ADVANCE;
    }
    else
    {
      width += ST7789_CJK_WIDTH;
      (void)is_valid;
    }
  }

  return width;
}

/* 计算大字号 UTF-8 字符串在屏幕上的显示宽度。 */
uint16_t ST7789_GetLargeStringWidth(const char *str)
{
  uint16_t width = 0U;
  uint16_t i = 0U;

  if (str == NULL)
  {
    return 0U;
  }

  while (str[i] != '\0')
  {
    uint32_t codepoint = 0U;
    (void)ST7789_ReadUtf8Codepoint(str, &i, &codepoint);
    width += (codepoint < 0x80U) ?
             (uint16_t)((ST7789_FONT_WIDTH * 5U + 1U) / 2U + 2U) :
             (uint16_t)(ST7789_CJK_WIDTH * 5U / 4U);
  }
  return width;
}

/* 在给定宽度的区域内水平居中绘制字符串。 */
void ST7789_DrawCenteredString(uint16_t x, uint16_t y, uint16_t box_w, const char *str, uint16_t fg_color, uint16_t bg_color)
{
  uint16_t width = 0U;
  uint16_t start_x = x;

  if (str == NULL)
  {
    return;
  }

  width = ST7789_GetStringWidth(str);
  if (box_w > width)
  {
    start_x = x + (box_w - width) / 2U;
  }

  ST7789_DrawString(start_x, y, str, fg_color, bg_color);
}

/* 将有符号整数转换为文本并绘制到屏幕。 */
void ST7789_DrawNumber(uint16_t x, uint16_t y, int32_t value, uint16_t fg_color, uint16_t bg_color)
{
  char text[16];
  snprintf(text, sizeof(text), "%ld", (long)value);
  ST7789_DrawString(x, y, text, fg_color, bg_color);
}

/*
 * 复位并配置 ST7789 显示方向、色彩格式和显示状态。
 * 此处不再同步填充整屏；应用启动后由 BootSplash_Show() 提交首个
 * 完整帧，避免初始化阶段为发送整屏黑色像素而等待多轮 DMA 结束。
 */
void ST7789_Init(void)
{
  /* 复位后退出睡眠、设置方向和 RGB565 格式，再打开显示。 */
  ST7789_Reset();

  ST7789_WriteCommand(ST7789_SWRESET);
  HAL_Delay(150);

  ST7789_WriteCommand(ST7789_SLPOUT);
  HAL_Delay(120);

  ST7789_WriteCommand(ST7789_MADCTL);
  ST7789_WriteData(0x60);

  ST7789_WriteCommand(ST7789_COLMOD);
  ST7789_WriteData(0x55);

  ST7789_WriteCommand(ST7789_INVON);
  ST7789_WriteCommand(ST7789_NORON);
  ST7789_WriteCommand(ST7789_DISPON);
}
